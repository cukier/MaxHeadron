## main/Kconfig.projbuild
```kconfig
menu "Max Headron Configuration"

    config MAXHEADRON_I2C_SDA_GPIO
        int "I2C SDA GPIO"
        default 21
        help
            GPIO connected to the SSD1306's SDA pin.

    config MAXHEADRON_I2C_SCL_GPIO
        int "I2C SCL GPIO"
        default 22
        help
            GPIO connected to the SSD1306's SCL pin.

    config MAXHEADRON_I2C_ADDRESS
        hex "SSD1306 I2C address"
        default 0x3C
        help
            Most SSD1306 boards are 0x3C. Some are jumpered to 0x3D.

    choice MAXHEADRON_OLED_HEIGHT
        prompt "OLED panel height"
        default MAXHEADRON_OLED_HEIGHT_64
        help
            128x64 is the common size. Pick 128x32 if that's what you have.

        config MAXHEADRON_OLED_HEIGHT_64
            bool "128x64"
        config MAXHEADRON_OLED_HEIGHT_32
            bool "128x32"
    endchoice

    config MAXHEADRON_FRAME_DELAY_MS
        int "Target frame delay (ms)"
        default 50
        range 20 200
        help
            Time between frames. 50ms ~ 20fps, which comfortably fits the
            I2C bandwidth of a full 128x64 redraw at 400kHz.

    config MAXHEADRON_FACE_HAL_EYE
        bool "Draw the original HAL 9000 lens instead of the Max Headroom bust"
        default n
        help
            The very first face this project had: a single unblinking,
            concentric-ringed eye in a recessed panel (breathing dilation
            + occasional glint, no mouth, no bust). Leave off for the
            current Max Headroom-style talking bust.

    # Wi-Fi/Ethernet + MQTT remote expression is always built in (see
    # wifi.c/eth.c/mqtt.c): connects to the network and an MQTT broker (see
    # mqtt-broker/README.md) so messages published to the "express" topic
    # show up on the ticker in real time. These settings end up in
    # sdkconfig, which is gitignored - never put real credentials in
    # sdkconfig.defaults.

    config MAXHEADRON_USE_ETHERNET
        bool "Use W5500 Ethernet instead of Wi-Fi"
        default n
        help
            Same W5500 SPI Ethernet wiring/config as the ktech boards
            (~/workspace/ktech/src/ktech/main/eth.c). When enabled, wifi.c
            is skipped entirely and eth.c brings up the link instead - it
            still feeds the same mqtt_link_start().

    if MAXHEADRON_USE_ETHERNET

        config MAXHEADRON_ETH_SPI_MISO_GPIO
            int "W5500 SPI MISO GPIO"
            default 15

        config MAXHEADRON_ETH_SPI_MOSI_GPIO
            int "W5500 SPI MOSI GPIO"
            default 12

        config MAXHEADRON_ETH_SPI_SCLK_GPIO
            int "W5500 SPI SCLK GPIO"
            default 13

        config MAXHEADRON_ETH_SPI_CS_GPIO
            int "W5500 SPI CS (spics) GPIO"
            default 14

        config MAXHEADRON_ETH_INT_GPIO
            int "W5500 INT GPIO"
            default 4

        config MAXHEADRON_ETH_PHY_RESET_GPIO
            int "W5500 PHY reset GPIO"
            default 5

        config MAXHEADRON_ETH_PHY_ADDR
            int "W5500 PHY address"
            default 1

    endif

    if !MAXHEADRON_USE_ETHERNET

        config MAXHEADRON_WIFI_SSID
            string "Wi-Fi SSID"
            default ""

        config MAXHEADRON_WIFI_PASSWORD
            string "Wi-Fi password"
            default ""

        config MAXHEADRON_WIFI_CHANNEL
            int "Wi-Fi channel (0 = scan all channels)"
            default 6
            range 0 14
            help
                Pinning this to the AP's actual channel skips the full 1-14
                channel scan and connects directly, which is faster and more
                reliable on a crowded 2.4GHz band. Leave at 0 to scan
                normally. Default 6 assumes the KREBS router gets moved off
                the crowded channel 11 onto channel 6 (empty per an nmcli
                scan) - update this if the router ends up on a different
                channel.

    endif

    config MAXHEADRON_MQTT_BROKER_URI
        string "MQTT broker URI"
        default ""
        help
            e.g. wss://your-app.onrender.com/ (see mqtt-broker/README.md
            for why it has to be ws:// or wss://, not mqtt://).

    config MAXHEADRON_MQTT_USERNAME
        string "MQTT username"
        default "maxheadron"

    config MAXHEADRON_MQTT_PASSWORD
        string "MQTT password"
        default ""

    config MAXHEADRON_MQTT_TOPIC
        string "MQTT express topic"
        default "/maxheadron/express"

endmenu
```
